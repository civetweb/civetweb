## contrib/buildroot/Config.in
```kconfig
config BR2_PACKAGE_CIVETWEB
	bool "civetweb"
	depends on BR2_TOOLCHAIN_HAS_THREADS
	help
	  Full featured embedded web server with LUA support.
	  
	  https://sourceforge.net/projects/civetweb

if BR2_PACKAGE_CIVETWEB

config BR2_CIVETWEB_WITH_LUA
	bool "enable LUA support"
	help
	  Enable Lua support in Civetweb. Note that this will use a
	  version of Lua and Sqlite bundled within the Civetweb
	  sources, and not the packages from Buildroot.

endif

comment "civetweb requires a toolchain with PTHREAD support"
	depends on !BR2_TOOLCHAIN_HAS_THREADS
```
